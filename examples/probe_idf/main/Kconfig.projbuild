## examples/probe_idf/main/Kconfig.projbuild
```kconfig
menu "MotorControl-RS standalone board"
    config MOTORCONTROLRS_RS485_TX_PIN
        int "RS485 UART2 TX pin"
        range 0 48
        default 47
        help
            GPIO19 and GPIO20 are reserved for the USB console.
    config MOTORCONTROLRS_RS485_RX_PIN
        int "RS485 UART2 RX pin"
        range 0 48
        default 48
        help
            GPIO19 and GPIO20 are reserved for the USB console.
    config MOTORCONTROLRS_RS485_DE_PIN
        int "Combined DE/RE pin"
        range 0 48
        default 21
        help
            GPIO19 and GPIO20 are reserved for the USB console.
    config MOTORCONTROLRS_DE_ACTIVE_HIGH
        bool "High selects transmit"
        default y
    config MOTORCONTROLRS_RECEIVER_DISABLED_DURING_TX
        bool "Declared topology disables local receiver during TX"
        default y
    config MOTORCONTROLRS_BENCH_IO
        bool "Bench fixture outputs and input (bench command)"
        default y
        help
            Relays, MOSFETs and one isolated input on the bench board, used to
            drive and sense ESS terminals. Outputs are active high and start
            inactive. Set a pin to -1 to leave it absent. See docs/bench_io.md.
    config MOTORCONTROLRS_BENCH_RELAY1_PIN
        int "Relay 1 output pin"
        depends on MOTORCONTROLRS_BENCH_IO
        range -1 48
        default 45
    config MOTORCONTROLRS_BENCH_RELAY2_PIN
        int "Relay 2 output pin"
        depends on MOTORCONTROLRS_BENCH_IO
        range -1 48
        default 18
    config MOTORCONTROLRS_BENCH_MOSFET1_PIN
        int "MOSFET 1 output pin"
        depends on MOTORCONTROLRS_BENCH_IO
        range -1 48
        default 3
    config MOTORCONTROLRS_BENCH_MOSFET2_PIN
        int "MOSFET 2 output pin"
        depends on MOTORCONTROLRS_BENCH_IO
        range -1 48
        default 46
    config MOTORCONTROLRS_BENCH_AUX1_PIN
        int "Isolated input pin (active low)"
        depends on MOTORCONTROLRS_BENCH_IO
        range -1 48
        default 17
    config MOTORCONTROLRS_FIXTURE_WIRING
        bool "Board-declared drive terminal wiring (fixture table)"
        default y
        help
            Declares which drive terminals carry fixture wiring, per ESS
            address. The application applies it at boot, after useaddr and to
            new group members; host wiring commands override it for the
            session only. It changes no drive assignment. Defaults equal the
            Arduino table in examples/common/BoardPins.h (drives 1, 2 and 4
            with X0-X3 connected, drive 4 with Y0 connected). An invalid table
            makes every declaration unknown. See docs/bench_io.md.
    config MOTORCONTROLRS_FIXTURE_SLOT1_ADDRESS
        int "Slot 1 ESS address (0 leaves the slot unused)"
        depends on MOTORCONTROLRS_FIXTURE_WIRING
        range 0 247
        default 1
    config MOTORCONTROLRS_FIXTURE_SLOT1_INPUTS
        hex "Slot 1 connected inputs, bit n = Xn"
        depends on MOTORCONTROLRS_FIXTURE_WIRING
        range 0x0 0xF
        default 0xF
    config MOTORCONTROLRS_FIXTURE_SLOT1_OUTPUTS
        hex "Slot 1 connected outputs, bit n = Yn"
        depends on MOTORCONTROLRS_FIXTURE_WIRING
        range 0x0 0x3
        default 0x0
    config MOTORCONTROLRS_FIXTURE_SLOT2_ADDRESS
        int "Slot 2 ESS address (0 leaves the slot unused)"
        depends on MOTORCONTROLRS_FIXTURE_WIRING
        range 0 247
        default 2
    config MOTORCONTROLRS_FIXTURE_SLOT2_INPUTS
        hex "Slot 2 connected inputs, bit n = Xn"
        depends on MOTORCONTROLRS_FIXTURE_WIRING
        range 0x0 0xF
        default 0xF
    config MOTORCONTROLRS_FIXTURE_SLOT2_OUTPUTS
        hex "Slot 2 connected outputs, bit n = Yn"
        depends on MOTORCONTROLRS_FIXTURE_WIRING
        range 0x0 0x3
        default 0x0
    config MOTORCONTROLRS_FIXTURE_SLOT3_ADDRESS
        int "Slot 3 ESS address (0 leaves the slot unused)"
        depends on MOTORCONTROLRS_FIXTURE_WIRING
        range 0 247
        default 4
    config MOTORCONTROLRS_FIXTURE_SLOT3_INPUTS
        hex "Slot 3 connected inputs, bit n = Xn"
        depends on MOTORCONTROLRS_FIXTURE_WIRING
        range 0x0 0xF
        default 0xF
    config MOTORCONTROLRS_FIXTURE_SLOT3_OUTPUTS
        hex "Slot 3 connected outputs, bit n = Yn"
        depends on MOTORCONTROLRS_FIXTURE_WIRING
        range 0x0 0x3
        default 0x1
    config MOTORCONTROLRS_FIXTURE_SLOT4_ADDRESS
        int "Slot 4 ESS address (0 leaves the slot unused)"
        depends on MOTORCONTROLRS_FIXTURE_WIRING
        range 0 247
        default 0
    config MOTORCONTROLRS_FIXTURE_SLOT4_INPUTS
        hex "Slot 4 connected inputs, bit n = Xn"
        depends on MOTORCONTROLRS_FIXTURE_WIRING
        range 0x0 0xF
        default 0x0
    config MOTORCONTROLRS_FIXTURE_SLOT4_OUTPUTS
        hex "Slot 4 connected outputs, bit n = Yn"
        depends on MOTORCONTROLRS_FIXTURE_WIRING
        range 0x0 0x3
        default 0x0
endmenu
```
